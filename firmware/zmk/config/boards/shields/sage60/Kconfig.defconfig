## firmware/zmk/config/boards/shields/sage60/Kconfig.shield
```kconfig
# Copyright (c) 2026 Diwamoto_
# SPDX-License-Identifier: MIT

config SHIELD_SAGE60_LEFT
	def_bool $(shields_list_contains,sage60_left)

config SHIELD_SAGE60_RIGHT
	def_bool $(shields_list_contains,sage60_right)
```

## firmware/zmk/config/boards/shields/sage60_ec/Kconfig.defconfig
```kconfig
# Copyright (c) 2026 Diwamoto_
# SPDX-License-Identifier: MIT

if SHIELD_SAGE60_EC_LEFT

config ZMK_KEYBOARD_NAME
	default "Sage60 EC"

config ZMK_SPLIT_ROLE_CENTRAL
	default y

endif

if SHIELD_SAGE60_EC_LEFT || SHIELD_SAGE60_EC_RIGHT

config ZMK_SPLIT
	default y

endif
```

## firmware/zmk/config/boards/shields/sage60_ec/Kconfig.shield
```kconfig
# Copyright (c) 2026 Diwamoto_
# SPDX-License-Identifier: MIT

config SHIELD_SAGE60_EC_LEFT
	def_bool $(shields_list_contains,sage60_ec_left)

config SHIELD_SAGE60_EC_RIGHT
	def_bool $(shields_list_contains,sage60_ec_right)
```

## firmware/zmk/config/rotate/Kconfig
```kconfig
config SAGE60_INPUT_ROTATE
    bool "Rotate relative X/Y input by a fixed angle"
    default y
    depends on DT_HAS_SAGE60_INPUT_ROTATE_ENABLED && INPUT

config SAGE60_INPUT_GESTURE
    bool "Turn ball rolls on a held layer into key taps"
    default y
    depends on DT_HAS_SAGE60_INPUT_GESTURE_ENABLED && SAGE60_INPUT_ROTATE
```

## firmware/zmk/config/rotate/dts/bindings/sage60,input-gesture.yaml
```yaml
description: |
  Swallows ball motion and taps the first binding on a roll up, the second
  on a roll down (see rotate/gesture.c). Put it in a listener layer override.

compatible: "sage60,input-gesture"

include: ip_zero_param.yaml

properties:
  bindings:
    type: phandle-array
    required: true
    description: <up>, <down>
  threshold:
    type: int
    default: 50
    description: Counts of up/down roll that trigger a binding.
  rearm-ms:
    type: int
    default: 300
    description: Stillness after which the next roll can trigger again.
```

## firmware/zmk/config/rotate/dts/bindings/sage60,input-rotate.yaml
```yaml
description: |
  Re-reports REL_X/REL_Y from another input device rotated by a fixed angle.
  Positive angle turns motion clockwise on screen (rightward roll goes down).

compatible: "sage60,input-rotate"

properties:
  device:
    type: phandle
    required: true
  angle:
    type: int
    required: true
    description: Degrees. Tilt applied to sideways (X) rolls.
  angle-y:
    type: int
    description: Degrees. Tilt applied to up/down (Y) rolls. Defaults to angle.
  scale-pct:
    type: int
    default: 100
    description: Speed in percent (100 = unchanged).
  wake-threshold:
    type: int
    default: 0
    description: Counts of motion swallowed after the ball has been idle.
  idle-ms:
    type: int
    default: 200
    description: Stillness after which wake-threshold applies again.
```

## firmware/zmk/config/rotate/dts/bindings/sage60,scroll-scaler.yaml
```yaml
description: |
  Divides REL_X/REL_Y by the scroll divisor that case/site/tune.html sets
  (see rotate/input_rotate.c). Put it before zip_xy_to_scroll_mapper.

compatible: "sage60,scroll-scaler"

include: ip_zero_param.yaml
```

## firmware/zmk/config/rotate/dts/bindings/sage60,uart-tap.yaml
```yaml
description: |
  Sits in front of a UART and lets sage60's trackball tuning share it with
  ZMK Studio (see rotate/input_rotate.c). Point zmk,studio-rpc-uart here.

compatible: "sage60,uart-tap"

properties:
  uart:
    type: phandle
    required: true
```

## firmware/zmk/config/west.yml
```yaml
manifest:
  remotes:
    - name: zmkfirmware
      url-base: https://github.com/zmkfirmware
    - name: badjeff
      url-base: https://github.com/badjeff
    - name: petejohanson
      url-base: https://github.com/petejohanson
  projects:
    - name: zmk
      remote: zmkfirmware
      revision: 4dd95d7840eb3d5a3f59bb29fbf1ab054715ef85
      import: app/west.yml
    - name: zmk-pmw3610-driver
      remote: badjeff
      revision: 44b4a76b74d293a93cec4ccb7e04cb8d29c10f93
    # EC (capacitive) kscan driver + gpio mux + calibrator snippet
    - name: ec-support-zmk-module
      remote: petejohanson
      revision: main
  self:
    path: config
```
