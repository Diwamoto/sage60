/*
 * Copyright (c) 2026 Diwamoto_
 * SPDX-License-Identifier: MIT
 *
 * Sage60 EC - left half (central). Source: pcb/ec_main/ec.kicad_pcb (U2)
 *
 *  ADC  P0.02 (D0)   ROW0 P0.28 (D2)   SEL0 P1.13 (D8)    POWER P1.14 (D9)
 *  DISCHARGE P0.03   ROW1 P0.29 (D3)   SEL1 P1.03 (pad21) EN    P1.05 (pad22)
 *                    ROW2 P0.04 (D4)   SEL2 P1.12 (D7)
 *                    ROW3 P0.05 (D5)
 *                    ROW4 P1.11 (D6)
 */

#include "sage60_ec.dtsi"

&mux {
    select-gpios
        = <&gpio1 13 GPIO_ACTIVE_HIGH>   /* SEL0 */
        , <&gpio1  3 GPIO_ACTIVE_HIGH>   /* SEL1 */
        , <&gpio1 12 GPIO_ACTIVE_HIGH>   /* SEL2 */
        ;
    en-gpios = <&gpio1 5 GPIO_ACTIVE_LOW>;
};

&matrix {
    strobe-gpios
        = <&gpio0 28 GPIO_ACTIVE_HIGH>   /* ROW0 */
        , <&gpio0 29 GPIO_ACTIVE_HIGH>   /* ROW1 */
        , <&gpio0  4 GPIO_ACTIVE_HIGH>   /* ROW2 */
        , <&gpio0  5 GPIO_ACTIVE_HIGH>   /* ROW3 */
        , <&gpio1 11 GPIO_ACTIVE_HIGH>   /* ROW4 */
        ;
    input-gpios
        = <&mux 4 0>   /* COL0 */
        , <&mux 6 0>   /* COL1 */
        , <&mux 7 0>   /* COL2 */
        , <&mux 5 0>   /* COL3 */
        , <&mux 1 0>   /* COL4 */
        , <&mux 0 0>   /* COL5 */
        ;
    /* ROW4 has no COL0/COL1 */
    strobe-input-masks = <0 0 0 0 (BIT(0) | BIT(1))>;
    drain-gpios = <&gpio0 3 GPIO_ACTIVE_HIGH>;
    power-gpios = <&gpio1 14 GPIO_ACTIVE_HIGH>;
};
